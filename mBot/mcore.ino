// generated by mBlock5 for mBot
// codes make you happy

#include <MeMCore.h>        // mBot hardware library
#include <Arduino.h>        // Core Arduino functions
#include <Wire.h>           // I2C communication
#include <SoftwareSerial.h> // Serial communication

MeIR ir;                             // IR remote receiver
MeUltrasonicSensor ultrasonic_3(3);  // Ultrasonic sensor on port 3
MeLEDMatrix ledMtx_2(2);             // LED matrix on port 2
unsigned char drawBuffer[16];        // Buffer for LED images
unsigned char *drawTemp;             // Temporary pointer for image data
MeRGBLed rgbled_7(7, 2);             // RGB LEDs on port 7 (2 LEDs)
MeDCMotor motor_9(9);                // Left or right motor (port 9)
MeDCMotor motor_10(10);              // The other motor (port 10)

const int OBSTACLE_DISTANCE = 14; // Stopping distance for obstacles (cm)
const int TURN_SPEED = 25;        // Speed for turning (%)
const int FORWARD_SPEED = 50;     // Normal drive speed (%)
const int ROTATION_SPEED = 20;    // Speed for rotating while scanning (%)

void move(int direction, int speed) {
  int leftSpeed = 0;
  int rightSpeed = 0;
  if(direction == 1) { // forward
    leftSpeed = speed;
    rightSpeed = speed;
  } else if(direction == 2) { // backward
    leftSpeed = -speed;
    rightSpeed = -speed;
  } else if(direction == 3) { // turn left
    leftSpeed = -speed;
    rightSpeed = speed;
  } else if(direction == 4) { // turn right
    leftSpeed = speed;
    rightSpeed = -speed;
  }
  motor_9.run((9) == M1 ? -(leftSpeed) : (leftSpeed));
  motor_10.run((10) == M1 ? -(rightSpeed) : (rightSpeed));
}

void _delay(float seconds) {
  long endTime = millis() + seconds * 1000;
  while(millis() < endTime) _loop();
}

bool isRunning = false;

void setup() {
  ir.begin();                       // Start IR receiver
  ledMtx_2.setColorIndex(1);        // Set LED matrix color
  ledMtx_2.setBrightness(6);        // Set LED matrix brightness
  rgbled_7.fillPixelsBak(0, 2, 1);  // Prep RGB LEDs

  while(1) {
    if (ir.keyPressed(69)) { // A button
      motor_9.run(0);
      motor_10.run(0);
      isRunning = false;
    }

    if (ir.keyPressed(70)) { // B button
      isRunning = true;
    }

    if (ir.keyPressed(71)) { // C button
      move(1, (100 / 100.0) * 255); // move forward at full speed
      _delay(3);
      motor_9.run(0);
      motor_10.run(0);
    }
    
 // Main Running Logic
    if (isRunning) {
      int distance = ultrasonic_3.distanceCm();
      if (distance < OBSTACLE_DISTANCE) {
        // Obstacle detected — rotate to find clear path
        motor_9.run(0);
        motor_10.run(0);

        bool isClear = false;

        // Start turning left
        move(3, (ROTATION_SPEED / 100.0) * 255);

        unsigned long startRotate = millis();
        
// Scan for a clear path by turning left in increments
        while (!isClear && (millis() - startRotate < 5000)) { // 5-second timeout
          int newDistance = ultrasonic_3.distanceCm();
          if (newDistance >= OBSTACLE_DISTANCE) {
            isClear = true;
            break;
          }
          delay(50); // Small delay to limit sensor reading rate
        }

        move(3, 0); // Stop rotation

        if (isClear) {
          move(1, (FORWARD_SPEED / 100.0) * 255); // Immediately move forward
        }

      } else {
        // No obstacle — move forward
        drawTemp = new unsigned char[16]{0,12,24,24,28,12,0,0,0,0,12,28,24,24,12,0};
        memcpy(drawBuffer, drawTemp, 16);
        free(drawTemp);
        ledMtx_2.drawBitmap(0, 0, 16, drawBuffer);

        move(1, (FORWARD_SPEED / 100.0) * 255); // move forward
      }
    }

    _loop();
  }
}

void _loop() {
  ir.loop();
}

void loop() {
  _loop();
}
